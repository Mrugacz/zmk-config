## boards/shields/dactylM/Kconfig.defconfig
```kconfig
if SHIELD_DACTYLM_DONGLE

config ZMK_KEYBOARD_NAME
	default "Dactyl"

config ZMK_SPLIT_BLE_ROLE_CENTRAL
	default y

config ZMK_USB
	default y

config ZMK_SPLIT
	default y

endif

if SHIELD_DACTYLM_LEFT || SHIELD_DACTYLM_RIGHT

config ZMK_SPLIT
	default y

endif
```

## boards/shields/dactylM/Kconfig.shield
```kconfig
config SHIELD_DACTYLM_LEFT
    def_bool $(shields_list_contains,dactylM_left)

config SHIELD_DACTYLM_RIGHT
    def_bool $(shields_list_contains,dactylM_right)

config SHIELD_DACTYLM_DONGLE
    def_bool $(shields_list_contains,dactylM_dongle)
```
